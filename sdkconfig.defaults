## sdkconfig.defaults
```kconfig
# ESP32-S3 VBot — sdkconfig.defaults
CONFIG_IDF_TARGET="esp32s3"

# Flash & Partition
CONFIG_ESPTOOLPY_FLASHSIZE_8MB=y
CONFIG_PARTITION_TABLE_CUSTOM=y
CONFIG_PARTITION_TABLE_CUSTOM_FILENAME="partitions.csv"

# CPU
CONFIG_ESP32S3_DEFAULT_CPU_FREQ_240=y

# PSRAM (OPI PSRAM trên ESP32-S3 Zero)
CONFIG_ESP32S3_SPIRAM_SUPPORT=y
CONFIG_SPIRAM_MODE_OCT=y
CONFIG_SPIRAM_SPEED_80M=y
CONFIG_SPIRAM_USE_MALLOC=y
CONFIG_SPIRAM_MALLOC_ALWAYSINTERNAL=65536

# WiFi
CONFIG_ESP_WIFI_TASK_PINNED_TO_CORE_0=y
CONFIG_ESP_WIFI_DYNAMIC_RX_BUFFER_NUM=32
CONFIG_ESP_WIFI_DYNAMIC_TX_BUFFER_NUM=32
CONFIG_ESP_WIFI_AMPDU_TX_ENABLED=y
CONFIG_ESP_WIFI_AMPDU_RX_ENABLED=y

# LWIP
CONFIG_LWIP_TCP_SND_BUF_DEFAULT=65535
CONFIG_LWIP_TCP_WND_DEFAULT=65535
CONFIG_LWIP_TCP_RECVMBOX_SIZE=32
CONFIG_LWIP_TCPIP_TASK_STACK_SIZE=4096

# HTTP Server
CONFIG_HTTPD_MAX_REQ_HDR_LEN=1024
CONFIG_HTTPD_MAX_URI_LEN=512

# WebSocket
CONFIG_ESP_WEBSOCKET_CLIENT_ENABLE=y

# NVS
CONFIG_NVS_ENCRYPTION=n

# FreeRTOS
CONFIG_FREERTOS_HZ=1000
CONFIG_FREERTOS_USE_TICKLESS_IDLE=n

# Logging
CONFIG_LOG_DEFAULT_LEVEL_INFO=y

# SPIFFS (for web UI files)
CONFIG_SPIFFS_PAGE_SIZE=256
CONFIG_SPIFFS_GC_MAX_RUNS=10

# USB Serial (for monitoring without UART)
CONFIG_ESP_CONSOLE_USB_CDC=y
CONFIG_ARDUINO_USB_CDC_ON_BOOT=1

# Stack sizes
CONFIG_MAIN_TASK_STACK_SIZE=8192

# I2C
CONFIG_I2C_ENABLE_DEBUG_LOG=n

# SPI
CONFIG_SPI_MASTER_IN_IRAM=y
```
